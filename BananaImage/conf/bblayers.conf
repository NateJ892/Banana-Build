## BananaImage/conf/bblayers.conf
```bitbake
# POKY_BBLAYERS_CONF_VERSION is increased each time build/conf/bblayers.conf
# changes incompatibly
POKY_BBLAYERS_CONF_VERSION = "2"

BBPATH = "${TOPDIR}"
BBFILES ?= ""

BBLAYERS ?= " \
  /home/osboxes/Desktop/Banana-Build/poky/meta \
  /home/osboxes/Desktop/Banana-Build/poky/meta-poky \
  /home/osboxes/Desktop/Banana-Build/poky/meta-yocto-bsp \
  /home/osboxes/Desktop/Banana-Build/BananaImage/meta-bananapi \
  /home/osboxes/Desktop/Banana-Build/meta-openembedded/meta-filesystems \
  /home/osboxes/Desktop/Banana-Build/meta-openembedded/meta-initramfs \
  /home/osboxes/Desktop/Banana-Build/meta-openembedded/meta-multimedia \
  /home/osboxes/Desktop/Banana-Build/meta-openembedded/meta-networking \
  /home/osboxes/Desktop/Banana-Build/meta-openembedded/meta-oe \
  /home/osboxes/Desktop/Banana-Build/meta-openembedded/meta-python \
  "
```

## BananaImage/meta-bananapi/conf/distro/bananapi.conf
```bitbake
DISTRO = "bananapi"

PACKAGE_CLASSES = "package_ipk"

DISTRO_NAME = "BananaPI"

DISTRO_FEATURES_append = " ext2 alsa systemd"

DISTRO_FEATURES_append_bananapi = " wifi"

VIRTUAL-RUNTIME_init_manager = "systemd"
DISTRO_FEATURES_BACKFILL_CONSIDERED = "sysvinit"
VIRTUAL-RUNTIME_initscripts = ""
```

## BananaImage/meta-bananapi/conf/machine/bananapi.conf
```bitbake
TARGET_ARCH = "arm"
require conf/machine/include/sun8i.inc

PREFERRED_PROVIDER_virtual/kernel = "linux-bananapi"
PREFERRED_PROVIDER_virtual/bootloader = "u-boot-bananapi"
KERNEL_IMAGETYPE = "zImage"

EXTRA_IMAGEDEPENDS += "u-boot-bananapi"

UBOOT_ENTRYPOINT  = "0x40008000"
UBOOT_LOADADDRESS = "0x40008000"
UBOOT_MACHINE = "Bananapi_M2_Ultra_defconfig"
SPL_BINARY ?= "u-boot-sunxi-with-spl.bin"

SERIAL_CONSOLE = "115200 ttyS0"

IMAGE_CLASSES += "sdcard_image-sunxi"
IMAGE_FSTYPES += "ext4 tar.xz jffs2 sunxi-sdimg"

MACHINE_ESSENTIAL_EXTRA_RDEPENDS = "kernel-image kernel-devicetree"

MACHINE_FEATURES = "ext2 ext4 tar.xz jffs2 serial usbhost vfat"
```
